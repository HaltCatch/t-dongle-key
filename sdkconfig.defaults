## tools/sd-audit/sdkconfig.defaults
```kconfig
CONFIG_IDF_TARGET="esp32s3"
CONFIG_APP_BUILD_TYPE_RAM=y
# CONFIG_APP_BUILD_TYPE_PURE_RAM_APP is not set
CONFIG_ESP_CONSOLE_USB_SERIAL_JTAG=y
CONFIG_VFS_SUPPORT_TERMIOS=n
CONFIG_ESP_SYSTEM_PANIC_PRINT_HALT=y
CONFIG_ESP_DEBUG_STUBS_ENABLE=n
CONFIG_ESP_ERR_TO_NAME_LOOKUP=n
CONFIG_ESP_MAIN_TASK_STACK_SIZE=8192
```
